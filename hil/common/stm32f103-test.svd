# STM32F103_TEST_SUBSET register map
File version: 1.0
Project test subset for STM32F103x8/xB; RM0008 and PM0056; not a full vendor SVD
Registers are 32-bit, read-write, no defined reset value unless marked. A register's access mark holds for its fields unless they carry their own. Offsets are from the block's base; lines under a group give offsets from that group; [hi:lo] are bit positions; {n}, {i} and the like mark numbered series; 'fields as' and 'values as' point back to an identical list; <NAME> marks a mode.

## Memory map
0x1FFFF7E0 FACTORY
0x40010800 GPIOA
0x40010C00 GPIOB
0x40011000 GPIOC
0x40012400 ADC1
0x40013800 USART1
0x40020000 DMA1
0x40020008 DMA1_Channel1
0x40021000 RCC
0xE000E010 SysTick
0xE000ED00 SCB
0xE0042000 DBGMCU

## RCC
Base 0x40021000
0x00 CR
0x04 CFGR
0x14 AHBENR
0x18 APB2ENR

## GPIOA
Base 0x40010800
Same registers: GPIOB 0x40010C00, GPIOC 0x40011000
0x00 CRL
0x04 CRH
0x08 IDR ro
0x0C ODR

## USART1
Base 0x40013800
0x00 SR ro read-modifies
0x08 BRR
0x0C CR1

## ADC1
Base 0x40012400
0x04 CR1
0x08 CR2
0x0C SMPR1
0x2C SQR1
0x34 SQR3
0x4C DR ro read-clears

## DMA1
Base 0x40020000
0x00 ISR ro
0x04 IFCR wo write-1-clears

## DMA1_Channel1
Base 0x40020008
0x00 CCR
0x04 CNDTR
0x08 CPAR
0x0C CMAR

## DBGMCU
Base 0xE0042000
0x00 IDCODE ro

## FACTORY
Base 0x1FFFF7E0
0x00 FLASH_SIZE 16-bit ro

## SCB
Base 0xE000ED00
0x04 ICSR

## SysTick
Base 0xE000E010
0x00 CTRL read-clears
0x04 LOAD
